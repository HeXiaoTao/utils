## mconf_test/Kconfig
```kconfig
#
# For a description of the syntax of this configuration file,
# see Documentation/kbuild/kconfig-language.txt.
# 
mainmenu "Kconfig Test"
			   
config HELLO_MAIN
       bool "Main"  
       default n 
       help 
               This is main file MAIN.

menu "hello"
source "hello/Kconfig"
endmenu
```

## mconf_test/hello/Kconfig
```kconfig
#
# For a description of the syntax of this configuration file,
# see Documentation/kbuild/kconfig-language.txt.
#
config HELLO_A 
       bool "A"  
       default n 
       help 
               This is hello file A.
config HELLO_B 
       bool "B"  
       default n 
       help 
               This is hello file B.
```
